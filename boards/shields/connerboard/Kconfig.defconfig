## boards/shields/connerboard/Kconfig.defconfig
```kconfig
if SHIELD_CONNERBOARD_LEFT

config ZMK_KEYBOARD_NAME
    default "CONNERBOARD"

config ZMK_SPLIT_ROLE_CENTRAL
    default y

endif # SHIELD_CONNERBOARD_LEFT

if SHIELD_CONNERBOARD_LEFT || SHIELD_CONNERBOARD_RIGHT

config ZMK_SPLIT
    default y

endif # SHIELD_CONNERBOARD_LEFT || SHIELD_CONNERBOARD_RIGHT
```

## boards/shields/connerboard/Kconfig.shield
```kconfig
config SHIELD_CONNERBOARD_LEFT
    def_bool $(shields_list_contains,connerboard_left)

config SHIELD_CONNERBOARD_RIGHT
    def_bool $(shields_list_contains,connerboard_right)
```
